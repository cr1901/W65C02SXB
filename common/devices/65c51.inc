.DEFINE PARITY_MASK BITS(%1, 0) EXPORT
.DEFINE PARITY_ERR PARITY_MASK EXPORT
.DEFINE NO_PARITY_ERR 0 EXPORT
.DEFINE FRAME_MASK BITS(%1, 1) EXPORT
.DEFINE FRAME_ERR FRAME_MASK EXPORT
.DEFINE NO_FRAME_ERR 0 EXPORT
.DEFINE OVERRUN_MASK BITS(%1, 2) EXPORT
.DEFINE OVERRUN OVERRUN_MASK EXPORT
.DEFINE NO_OVERRUN 0 EXPORT
.DEFINE RDR_STATUS_MASK BITS(%1, 3) EXPORT
.DEFINE RDR_FULL RDR_STATUS_MASK EXPORT
.DEFINE RDR_EMPTY 0 EXPORT
.DEFINE TDR_STATUS_MASK BITS(%1, 4) EXPORT
.DEFINE TDR_FULL TDR_STATUS_MASK 
.DEFINE TDR_EMPTY 0 EXPORT
.DEFINE DCD_STATUS_MASK BITS(%1, 5) EXPORT
.DEFINE DCD_NO_DETECT DCD_STATUS_MASK EXPORT
.DEFINE DCD_DETECT 0 EXPORT
.DEFINE DSR_STATUS_MASK BITS(%1, 6) EXPORT
.DEFINE DSR_NOT_READY DSR_STATUS_MASK EXPORT
.DEFINE DSR_READY 0 EXPORT
.DEFINE ACIA_IRQ_MASK BITS(%1, 7) EXPORT
.DEFINE ACIA_IRQ ACIA_IRQ_MASK EXPORT
.DEFINE NO_ACIA_IRQ 0 EXPORT

.DEFINE BAUD_DIV_MASK BITS(%1111, 0) EXPORT
.DEFINE BAUD_DIV_36864 BITS(%0001, 0) EXPORT
.DEFINE BAUD_DIV_24576 BITS(%0010, 0) EXPORT
.DEFINE BAUD_DIV_16769 BITS(%0011, 0) EXPORT
.DEFINE BAUD_DIV_13704 BITS(%0100, 0) EXPORT
.DEFINE BAUD_DIV_12288 BITS(%0101, 0) EXPORT
.DEFINE BAUD_DIV_6144 BITS(%0110, 0) EXPORT
.DEFINE BAUD_DIV_3072 BITS(%0111, 0) EXPORT
.DEFINE BAUD_DIV_1536 BITS(%1000, 0) EXPORT
.DEFINE BAUD_DIV_1024 BITS(%1001, 0) EXPORT
.DEFINE BAUD_DIV_768 BITS(%1010, 0) EXPORT
.DEFINE BAUD_DIV_512 BITS(%1011, 0) EXPORT
.DEFINE BAUD_DIV_384 BITS(%1100, 0) EXPORT
.DEFINE BAUD_DIV_256 BITS(%1101, 0) EXPORT
.DEFINE BAUD_DIV_192 BITS(%1110, 0) EXPORT
.DEFINE BAUD_DIV_96 BAUD_DIV_MASK EXPORT
.DEFINE BAUD_DIV_16 0 EXPORT
.DEFINE RX_CLK_MASK BITS(%1, 4) EXPORT
.DEFINE INTERNAL_RX_CLK RX_CLK_MASK EXPORT
.DEFINE EXTERNAL_RX_CLK 0 EXPORT
.DEFINE BITS_MASK BITS(%11, 5) EXPORT
.DEFINE BITS_8 BITS(%00, 5) EXPORT
.DEFINE BITS_7 BITS(%01, 5) EXPORT
.DEFINE BITS_6 BITS(%10, 5) EXPORT
.DEFINE BITS_5 BITS_MASK EXPORT
.DEFINE STOP_BITS_MASK BITS(%1, 7) EXPORT
.DEFINE TWO_STOP_BITS STOP_BITS_MASK EXPORT
.DEFINE ONE_HALF_STOP_BITS TWO_STOP_BITS EXPORT
.DEFINE ONE_STOP_BIT 0 EXPORT

.DEFINE DTR_MASK BITS(%1, 0) EXPORT
.DEFINE DTR_LOW DTR_MASK EXPORT
.DEFINE DTR_HIGH 0 EXPORT
.DEFINE RX_IRQ_MASK BITS(%1, 1) EXPORT
.DEFINE DISABLE_RX_IRQ RX_IRQ_MASK EXPORT
.DEFINE ENABLE_RX_IRQ 0 EXPORT
.DEFINE RTX_TX_IRQ_MASK BITS(%11, 2) EXPORT
.DEFINE ENABLE_TX_IRQ BITS(%01, 2) EXPORT
.DEFINE RTS_LOW BITS(%10, 2) EXPORT
.DEFINE DISABLE_TX_IRQ RTS_LOW EXPORT
.DEFINE XMIT_BRK RTX_TX_IRQ_MASK EXPORT
.DEFINE RTS_HIGH 0 EXPORT
.DEFINE MODE_MASK BITS(%1, 4) EXPORT
.DEFINE ECHO_MODE MODE_MASK EXPORT
.DEFINE NORMAL_MODE 0 EXPORT
.DEFINE PARITY_MODE_MASK BITS(%111, 5) EXPORT
.DEFINE ODD_PARITY BITS(%001, 5) EXPORT
.DEFINE EVEN_PARITY BITS(%011, 5) EXPORT
.DEFINE MARK_PARITY BITS(%101, 5) EXPORT
.DEFINE SPACE_PARITY PARITY_MODE_MASK EXPORT
.DEFINE DISABLE_PARITY 0 EXPORT

.STRUCT ACIA
TDR .DB
RDR DB
STAT DB
CMD DB
CTRL DB
.ENDST
