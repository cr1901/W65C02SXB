.INCLUDE "header.inc"
.INCLUDE "macros.inc"

; Generated from C source in: http://www.ross.net/crc/download/crc_v3.txt.
; Although 16 entry tables could be done by hand if you had to.
;
; A 256-table entry can be generated by doing two nibbles XOR'ed together,
; where H_entry is high nibble and L_entry is low nibble.
; TODO: Assuming I didn't screw up the below formula... Potential optimization?
;
; (table[H_entry] << 4) ^ table[((table[H_entry] >> 12) ^ L_entry)]

; CRC-16/XMODEM
.BANK 0 SLOT 1
.SECTION "CRCTables"
xmodem_crc_table .DW 0x0000, 0x1021, 0x2042, 0x3063, 0x4084, 0x50A5, 0x60C6, 0x70E7, \
            0x8108, 0x9129, 0xA14A, 0xB16B, 0xC18C, 0xD1AD, 0xE1CE, 0xF1EF

; A refin/refout = true nibble table uses table entries 0, 0x10, 0x20, 0x30, etc
; because the message is shifted in LSB first. So we chomp the _trailing_ zero
; as a noop.
; The math works out, trust me. I did hand calculations.
kermit_crc_table .DW 0x0000, 0x1081, 0x2102, 0x3183, 0x4204, 0x5285, 0x6306, 0x7387, \
    0x8408, 0x9489, 0xA50A, 0xB58B, 0xC60C, 0xD68D, 0xE70E, 0xF78F
.ENDS

.RAMSECTION "CRCZP" SLOT 0
crc_xorval: DW
ptr_hex: DW
.ENDS

.RAMSECTION "CRCVars" SLOT 0 ORG $200
.ENDS

.BANK 0 SLOT 1
.SECTION "ENTRY"
entry:
    jsr serial_init
    ldy #1
    jsr init_crc

@next:
    lda.w check,Y
    jsr process_byte
    iny
    cpy.w check
    BLE @next

    LD16 crc_xorval, ptr_hex
    jsr printhex16

    ldy #1
    jsr init_crc
@next2:
    lda.w check,Y
    jsr process_byte_rev
    iny
    cpy.w check
    BLE @next2

    LD16 crc_xorval, ptr_hex
    jsr printhex16
@done:
    sta.w BUS0
    jmp @done

init_crc:
    STZ16 crc_xorval
    rts

process_byte:
    jsr process_nibble
    jsr process_nibble_lo
    rts

process_nibble_lo:
    pha
    asl
    asl
    asl
    asl
    jmp process_nibble@lo_begin

; Hi nibble, most-significant-bit is the one processed first.
process_nibble_hi:
process_nibble:
    pha
@lo_begin:
    eor crc_xorval + 1 ; XOR the high nibble of the last CRC val.
    lsr
    lsr
    lsr
    lsr
    asl ; Each table entry is 16 bits.
    pha ; Save it

    ; Get rid of high nibble of CRC.
    ldx #4
@shift:
    asl crc_xorval
    rol crc_xorval + 1
    dex
    bne @shift

    ; Index into CRC table.
    plx
    lda.w xmodem_crc_table,X
    eor crc_xorval
    sta crc_xorval
    lda.w xmodem_crc_table + 1,X
    eor crc_xorval + 1
    sta crc_xorval + 1

    pla
    rts

; Low nibble, least-significant-bit is the one processed first.
process_byte_rev:
    jsr process_nibble_rev
    jsr process_nibble_hi_rev
    rts

process_nibble_hi_rev:
    pha
    lsr
    lsr
    lsr
    lsr
    jmp process_nibble_rev@hi_begin

; Low nibble, least-significant bit is the one processed first.
process_nibble_lo_rev:
process_nibble_rev:
    pha
@hi_begin:
    eor crc_xorval ; XOR the low nibble of the last CRC val.
    and #%00001111
    asl ; Each table entry is 16 bits.
    pha ; Save it

    ; Get rid of low nibble of CRC.
    ldx #4
@shift:
    lsr crc_xorval + 1
    ror crc_xorval
    dex
    bne @shift

    ; Index into CRC table.
    plx
    lda.w kermit_crc_table,X
    eor crc_xorval
    sta crc_xorval
    lda.w kermit_crc_table + 1,X
    eor crc_xorval + 1
    sta crc_xorval + 1

    pla
    rts

hex2ascii:
    and #%00001111
    cmp #0xA
    bcs @a_to_f
    adc #'0'
    rts
@a_to_f:
    adc #('A' - 10 - 1) ; Carry is set, so add one less.
    rts

; Print hex number pointed to by ptr_hex to ACIA.
; FIXME: Not memory safe (ptr length not verified).
; Clobbers: A, X, ptr_hex
printhex16:
    lda #'0'
    jsr putc
    lda #'x'
    jsr putc
    clc
    lda ptr_hex
    adc #1
    sta ptr_hex
    lda ptr_hex + 1
    adc #0
    sta ptr_hex + 1
    lda (ptr_hex)
    lsr
    lsr
    lsr
    lsr
    jsr hex2ascii
    jsr putc
    lda (ptr_hex)
    jsr hex2ascii
    jsr putc
    sec
    lda ptr_hex
    sbc #1
    sta ptr_hex
    lda ptr_hex + 1
    sbc #0
    sta ptr_hex + 1
    lda (ptr_hex)
    lsr
    lsr
    lsr
    lsr
    jsr hex2ascii
    jsr putc
    lda (ptr_hex)
    jsr hex2ascii
    jsr putc
    lda #0xA
    jsr putc
    rts

PSTR check, "123456789"
.ENDS

.SECTION "VectorsImpl"
irq:
    jmp serial_isr

unused:
    jmp unused
.ENDS

; FIXME: WLA doesn't handle ROM/RAM collisions well...
; Bare .ORGA without a section also works, but at least this signifies intent.
; The user is _expected_ to overwrite these debugger vars.
.BANK 0 SLOT 1
.SECTION "Vectors" OVERWRITE ORGA VECTOR_ORG
.dw unused
.dw entry
.dw serial_isr
.ENDS
